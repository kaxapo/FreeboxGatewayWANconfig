## fbxatm/Kconfig
```kconfig
menuconfig FBXATM
	tristate "Freebox Asynchronous Transfer Mode (ATM)"

if FBXATM

config FBXATM_REMOTE
	bool

choice
	prompt "mode"
	default FBXATM_STACK

config FBXATM_STACK
	bool "standard"

config FBXATM_REMOTE_STUB
	bool "remote stub"
	select FBXATM_REMOTE

endchoice

config FBXATM_REMOTE_DRIVER
	tristate "remote fbxatm driver"
	depends on FBXATM_STACK
	select FBXATM_REMOTE
	default n

endif
```

## fbxmtd/Kconfig
```kconfig
menuconfig FREEBOX_MTD
	tristate "Freebox Memory Technology Devices (FBXMTD) support"

if FREEBOX_MTD

config FREEBOX_MTD_BACKEND_AMD
	bool "Support for AMD compatible flash"

config FREEBOX_MTD_BACKEND_INTEL
	bool "Support for Intel Strataflash"

config FREEBOX_MTD_BLK
	tristate "Block device access to fbxmtd"
	depends on BLOCK

config FREEBOX_MTD_CHAR
	tristate "Character device access to fbxmtd"


comment "Mapping drivers"

#
# Generic mapping driver.
#
config FREEBOX_MTD_MAP_DRV_FBX
	tristate "Freebox mapping Driver."
	select CRC32

config FREEBOX_MTD_MAP_DRV_BCM963XX
	tristate "Broadcom 963xx flash format"
	select CRC32

#
# Freebox MTD Map Control interface
#
config FREEBOX_MTD_MAP_IOCTL
	tristate "IOCTL control interface"
	depends on FREEBOX_MTD_MAP_DRV_FBX

endif
```

## fbxwatchdog/Kconfig
```kconfig
menuconfig FREEBOX_WATCHDOG
	tristate "Freebox Watchdog"
	default n

if FREEBOX_WATCHDOG

config FREEBOX_WATCHDOG_CHAR
	bool "Freebox Watchdog char device interface."
	default n

config FREEBOX_WATCHDOG_ORION
	tristate "Marvell Orion support"
	depends on PLAT_ORION

config FREEBOX_WATCHDOG_BCM63XX
	tristate "Broadcom 63xx Freebox Watchdog support"
	depends on BCM63XX
	default n

endif
```
